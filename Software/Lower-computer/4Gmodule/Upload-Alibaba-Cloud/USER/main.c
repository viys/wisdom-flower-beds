/***********************************************温湿度上传阿里云程序************************************************************/
//修改日期：2023年3月14日
//修改人：李宇杰
/*更新日志：

*/

//硬件平台：STM32F103RC 频率：72MHz     BC26 4G模块      温湿度传感器DHT11（只做示例）

/*    程序内容
串口1与BC26通信
串口2做测试 与电脑通信(只做测试（在电脑上显示单片机与BC26通信情况）不使用不会有影响)
定时器6辅助串口1接收数据
温湿度传感器：DHT11（只做示例）
*/

//--------------------------------------------程序代码------------------------------------------------------------//
#include "stm32f10x.h"
#include "delay.h"
#include "usart.h"
#include "tim6.h"
#include "bc26.h"
#include "mqtt.h"
#include "dht11.h"

u8 tem,hum;//定义温湿度

//主函数
int main()
{
	USART1_Config();//串口1初始化
	USART2_Config();//串口2初始化
	
	//根据波特率115200 可知1s可传输11520个字节 故10ms可传输115个字节 针对本程序 完全够用
	TIM6_Inter_Init(7200,100); //10ms中断
	USART1_RX_STA=0;	//串口1数据接收标志位清零
	
	DHT11_Init();//DHT11初始化
	
	//等待BC26初始化成功
	while(!(BC26_Init()))
	{
		To_Computer((u8 *)"\r\nBC26初始化失败！\r\n正在重试...\r\n\r\n");
		delay_s(1);
	}
  //等待MQTT初始化成功
	while(!(MQTT_Init()))
	{
		To_Computer((u8 *)"\r\nMQTT初始化失败！\r\n正在重试...\r\n\r\n");
		delay_s(1);
	}
		
	//主循环
	while(1)
	{
		DHT11_ReadData(&hum,&tem);//DHT11读取温湿度值
		if(!(Data_Send(tem,hum)))//给服务器发送数据
		{
			To_Computer((u8 *)"数据发送失败\r\n");
		}
	}
}
//--------------------------------------------程序代码------------------------------------------------------------//
